## Documentation/devicetree/bindings/display/panel/maxen,b70hm30.yaml
```yaml
# SPDX-License-Identifier: (GPL-2.0+ OR X11)
%YAML 1.2
---
$id: http://devicetree.org/schemas/display/panel/maxen,b70hm30.yaml#
$schema: http://devicetree.org/meta-schemas/core.yaml#

title: Maxen Electronics B70HM30 DSI Display Panel

maintainers:
  - Luke Howard <lukeh@padl.com>

properties:
  compatible:
    const: maxen,b70hm30

  reg:
    maxItems: 1

  power-gpios:
    description: GPIO used for the power pin
    maxItems: 1

  reset-gpios:
    description: GPIO used for the reset pin
    maxItems: 1

  shlr-gpios:
    description: GPIO used for the shlr pin (horizontal flip)
    maxItems: 1

  updn-gpios:
    description: GPIO used for the updn pin (vertical flip)
    maxItems: 1

  vcc-lcd-supply:
    description: Power regulator

  backlight:
    description: Backlight used by the panel
    $ref: /schemas/types.yaml#/definitions/phandle

required:
  - compatible
  - power-gpios
  - reg
  - reset-gpios
  - shlr-gpios
  - updn-gpios
  - vcc-lcd-supply

additionalProperties: false
```

## Documentation/devicetree/bindings/display/panel/yousee,yx070amsha01.yaml
```yaml
# SPDX-License-Identifier: (GPL-2.0+ OR X11)
%YAML 1.2
---
$id: http://devicetree.org/schemas/display/panel/yousee,yx070amsha01.yaml#
$schema: http://devicetree.org/meta-schemas/core.yaml#

title: Yousee YX070AMSHA01 DSI Display Panel

maintainers:
  - Luke Howard <lukeh@padl.com>

properties:
  compatible:
    const: yousee,yx070amsha01

  reg:
    maxItems: 1

  reset-gpios:
    description: GPIO used for the reset pin
    maxItems: 1

  vcc-lcd-supply:
    description: Power regulator


required:
  - compatible
  - reg
  - reset-gpios
  - vcc-lcd-supply

additionalProperties: false
```

## Documentation/devicetree/bindings/input/padl,xebra-tail-encoder.yaml
```yaml
# SPDX-License-Identifier: (GPL-2.0-only OR BSD-2-Clause)
%YAML 1.2
---
$id: http://devicetree.org/schemas/input/padl,xebra-tail-encoder.yaml#
$schema: http://devicetree.org/meta-schemas/core.yaml#

title: XEBRA tail rotary encoders

maintainers:
  - Luke Howard <lukeh@padl.com>

description: |
  The XEBRA tail is a microcontroller that reports the deltas of up to eight
  rotary encoders, and the states of their push switches, over I2C. It can
  also hold an interrupt line low while it has unread events. Without an
  interrupt the device is polled.

  Each encoder the board uses is described by a child node, which gives the
  relative axis its rotation is reported on and, optionally, the key code of
  its switch. Encoders without a child node are not reported.

properties:
  compatible:
    const: padl,xebra-tail-encoder

  reg:
    maxItems: 1

  interrupts:
    maxItems: 1
    description:
      Encoder interrupt line, asserted until the pending events are read.
      Should be level triggered.

  poll-interval:
    $ref: /schemas/types.yaml#/definitions/uint32
    description:
      Interval in milliseconds between reads while the encoders are in use.
    default: 33

  "#address-cells":
    const: 1

  "#size-cells":
    const: 0

patternProperties:
  "^encoder@[0-7]$":
    type: object
    additionalProperties: false

    properties:
      reg:
        maxItems: 1
        description: Index of the encoder on the tail.

      label:
        description: Name of the control.

      linux,axis:
        $ref: /schemas/types.yaml#/definitions/uint32
        description: Relative axis (REL_*) that rotation is reported on.

      linux,code:
        $ref: /schemas/types.yaml#/definitions/uint32
        description: Key code reported by the encoder's switch.

    required:
      - reg
      - linux,axis

required:
  - compatible
  - reg
  - "#address-cells"
  - "#size-cells"

additionalProperties: false

examples:
  - |
    #include <dt-bindings/input/input.h>
    #include <dt-bindings/interrupt-controller/irq.h>

    i2c {
        #address-cells = <1>;
        #size-cells = <0>;

        encoders@44 {
            compatible = "padl,xebra-tail-encoder";
            reg = <0x44>;
            interrupt-parent = <&gpio>;
            interrupts = <25 IRQ_TYPE_LEVEL_LOW>;
            #address-cells = <1>;
            #size-cells = <0>;

            encoder@2 {
                reg = <2>;
                label = "Main";
                linux,axis = <REL_DIAL>;
                linux,code = <BTN_0>;
            };
        };
    };
```

## net/bridge/Kconfig
```kconfig
# SPDX-License-Identifier: GPL-2.0-only
#
# 802.1d Ethernet Bridging
#

config BRIDGE
	tristate "802.1d Ethernet Bridging"
	select LLC
	select STP
	help
	  If you say Y here, then your Linux box will be able to act as an
	  Ethernet bridge, which means that the different Ethernet segments it
	  is connected to will appear as one Ethernet to the participants.
	  Several such bridges can work together to create even larger
	  networks of Ethernets using the IEEE 802.1 spanning tree algorithm.
	  As this is a standard, Linux bridges will cooperate properly with
	  other third party bridge products.

	  In order to use the Ethernet bridge, you'll need the bridge
	  configuration tools; see <file:Documentation/networking/bridge.rst>
	  for location. Please read the Bridge mini-HOWTO for more
	  information.

	  If you enable iptables support along with the bridge support then you
	  turn your bridge into a bridging IP firewall.
	  iptables will then see the IP packets being bridged, so you need to
	  take this into account when setting up your firewall rules.
	  Enabling arptables support when bridging will let arptables see
	  bridged ARP traffic in the arptables FORWARD chain.

	  To compile this code as a module, choose M here: the module
	  will be called bridge.

	  If unsure, say N.

config BRIDGE_IGMP_SNOOPING
	bool "IGMP/MLD snooping"
	depends on BRIDGE
	depends on INET
	default y
	help
	  If you say Y here, then the Ethernet bridge will be able selectively
	  forward multicast traffic based on IGMP/MLD traffic received from
	  each port.

	  Say N to exclude this support and reduce the binary size.

	  If unsure, say Y.

config BRIDGE_8021Q_SRP
	bool "802.1Qat Stream Reservation Protocol (SRP) admission control"
	depends on BRIDGE
	default n
	help
	  If you say Y here, then the Ethernet bridge will enforce 802.1Qat
	  stream reservation admission control in software on ingress ports
	  that have the BR_FILTER_STREAM_RESERVED flag set: a frame whose
	  802.1p priority maps (via an MQPRIO/TAPRIO Qdisc on the bridge) to
	  a non-zero traffic class is dropped unless it is multicast and its
	  destination address MDB_FLAGS_STREAM_RESERVED set on its MDB entry.

	  This option only controls software enforcement. The
	  BR_FILTER_STREAM_RESERVED port flag and MDB_FLAGS_STREAM_RESERVED
	  MDB flag are always accepted from user space and propagated via
	  switchdev so that hardware-offloading switches can enforce
	  admission control even when this option is disabled.

	  Say N to exclude software enforcement and reduce the binary size.

	  If unsure, say N.

config BRIDGE_VLAN_FILTERING
	bool "VLAN filtering"
	depends on BRIDGE
	depends on VLAN_8021Q
	default n
	help
	  If you say Y here, then the Ethernet bridge will be able selectively
	  receive and forward traffic based on VLAN information in the packet
	  any VLAN information configured on the bridge port or bridge device.

	  Say N to exclude this support and reduce the binary size.

	  If unsure, say Y.

config BRIDGE_MRP
	bool "MRP protocol"
	depends on BRIDGE
	default n
	help
	  If you say Y here, then the Ethernet bridge will be able to run MRP
	  protocol to detect loops

	  Say N to exclude this support and reduce the binary size.

	  If unsure, say N.

config BRIDGE_CFM
	bool "CFM protocol"
	depends on BRIDGE
	help
	  If you say Y here, then the Ethernet bridge will be able to run CFM
	  protocol according to 802.1Q section 12.14

	  Say N to exclude this support and reduce the binary size.

	  If unsure, say N.
```
